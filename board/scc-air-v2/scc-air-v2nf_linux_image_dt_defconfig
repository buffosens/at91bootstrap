## board/scc-air-v2/scc-air-v2nf_linux_image_dt_defconfig
```kconfig
CONFIG_SAMA5D3_XPLAINED=y
CONFIG_RAM_512MB=y
CONFIG_NANDFLASH=y
# CONFIG_PMECC_AUTO_DETECT is not set
CONFIG_CPU_CLK_528MHZ=y
CONFIG_PMECC_CORRECT_BITS_8=y
CONFIG_LOAD_LINUX=y
CONFIG_OVERRIDE_CMDLINE=y
CONFIG_DEBUG=y
```
